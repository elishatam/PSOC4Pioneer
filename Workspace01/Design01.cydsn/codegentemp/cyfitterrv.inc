    IF :LNOT::DEF:INCLUDED_CYFITTERRV_INC
INCLUDED_CYFITTERRV_INC EQU 1
    GET cydevicerv_trm.inc

; Pin_Vin
Pin_Vin__0__DM__MASK EQU 0x7000
Pin_Vin__0__DM__SHIFT EQU 12
Pin_Vin__0__DR EQU CYREG_PRT0_DR
Pin_Vin__0__HSIOM EQU CYREG_HSIOM_PORT_SEL0
Pin_Vin__0__HSIOM_MASK EQU 0x000F0000
Pin_Vin__0__HSIOM_SHIFT EQU 16
Pin_Vin__0__INTCFG EQU CYREG_PRT0_INTCFG
Pin_Vin__0__INTSTAT EQU CYREG_PRT0_INTSTAT
Pin_Vin__0__MASK EQU 0x10
Pin_Vin__0__OUT_SEL EQU CYREG_UDB_PA0_CFG10
Pin_Vin__0__OUT_SEL_SHIFT EQU 8
Pin_Vin__0__OUT_SEL_VAL EQU 3
Pin_Vin__0__PA__CFG0 EQU CYREG_UDB_PA0_CFG0
Pin_Vin__0__PA__CFG1 EQU CYREG_UDB_PA0_CFG1
Pin_Vin__0__PA__CFG10 EQU CYREG_UDB_PA0_CFG10
Pin_Vin__0__PA__CFG11 EQU CYREG_UDB_PA0_CFG11
Pin_Vin__0__PA__CFG12 EQU CYREG_UDB_PA0_CFG12
Pin_Vin__0__PA__CFG13 EQU CYREG_UDB_PA0_CFG13
Pin_Vin__0__PA__CFG14 EQU CYREG_UDB_PA0_CFG14
Pin_Vin__0__PA__CFG2 EQU CYREG_UDB_PA0_CFG2
Pin_Vin__0__PA__CFG3 EQU CYREG_UDB_PA0_CFG3
Pin_Vin__0__PA__CFG4 EQU CYREG_UDB_PA0_CFG4
Pin_Vin__0__PA__CFG5 EQU CYREG_UDB_PA0_CFG5
Pin_Vin__0__PA__CFG6 EQU CYREG_UDB_PA0_CFG6
Pin_Vin__0__PA__CFG7 EQU CYREG_UDB_PA0_CFG7
Pin_Vin__0__PA__CFG8 EQU CYREG_UDB_PA0_CFG8
Pin_Vin__0__PA__CFG9 EQU CYREG_UDB_PA0_CFG9
Pin_Vin__0__PC EQU CYREG_PRT0_PC
Pin_Vin__0__PC2 EQU CYREG_PRT0_PC2
Pin_Vin__0__PORT EQU 0
Pin_Vin__0__PS EQU CYREG_PRT0_PS
Pin_Vin__0__SHIFT EQU 4
Pin_Vin__DR EQU CYREG_PRT0_DR
Pin_Vin__INTCFG EQU CYREG_PRT0_INTCFG
Pin_Vin__INTSTAT EQU CYREG_PRT0_INTSTAT
Pin_Vin__MASK EQU 0x10
Pin_Vin__PA__CFG0 EQU CYREG_UDB_PA0_CFG0
Pin_Vin__PA__CFG1 EQU CYREG_UDB_PA0_CFG1
Pin_Vin__PA__CFG10 EQU CYREG_UDB_PA0_CFG10
Pin_Vin__PA__CFG11 EQU CYREG_UDB_PA0_CFG11
Pin_Vin__PA__CFG12 EQU CYREG_UDB_PA0_CFG12
Pin_Vin__PA__CFG13 EQU CYREG_UDB_PA0_CFG13
Pin_Vin__PA__CFG14 EQU CYREG_UDB_PA0_CFG14
Pin_Vin__PA__CFG2 EQU CYREG_UDB_PA0_CFG2
Pin_Vin__PA__CFG3 EQU CYREG_UDB_PA0_CFG3
Pin_Vin__PA__CFG4 EQU CYREG_UDB_PA0_CFG4
Pin_Vin__PA__CFG5 EQU CYREG_UDB_PA0_CFG5
Pin_Vin__PA__CFG6 EQU CYREG_UDB_PA0_CFG6
Pin_Vin__PA__CFG7 EQU CYREG_UDB_PA0_CFG7
Pin_Vin__PA__CFG8 EQU CYREG_UDB_PA0_CFG8
Pin_Vin__PA__CFG9 EQU CYREG_UDB_PA0_CFG9
Pin_Vin__PC EQU CYREG_PRT0_PC
Pin_Vin__PC2 EQU CYREG_PRT0_PC2
Pin_Vin__PORT EQU 0
Pin_Vin__PS EQU CYREG_PRT0_PS
Pin_Vin__SHIFT EQU 4

; ADC_SAR_Seq_cy_psoc4_sar
ADC_SAR_Seq_cy_psoc4_sar__SAR_CTRL EQU CYREG_SAR_CTRL
ADC_SAR_Seq_cy_psoc4_sar__SAR_INTR EQU CYREG_SAR_INTR
ADC_SAR_Seq_cy_psoc4_sar__SAR_INTR_CAUSE EQU CYREG_SAR_INTR_CAUSE
ADC_SAR_Seq_cy_psoc4_sar__SAR_INTR_MASK EQU CYREG_SAR_INTR_MASK
ADC_SAR_Seq_cy_psoc4_sar__SAR_INTR_MASKED EQU CYREG_SAR_INTR_MASKED
ADC_SAR_Seq_cy_psoc4_sar__SAR_INTR_SET EQU CYREG_SAR_INTR_SET
ADC_SAR_Seq_cy_psoc4_sar__SAR_NUMBER EQU 0
ADC_SAR_Seq_cy_psoc4_sar__SAR_RANGE_COND EQU CYREG_SAR_RANGE_COND
ADC_SAR_Seq_cy_psoc4_sar__SAR_RANGE_INTR_MASK EQU CYREG_SAR_RANGE_INTR_MASK
ADC_SAR_Seq_cy_psoc4_sar__SAR_RANGE_INTR_MASKED EQU CYREG_SAR_RANGE_INTR_MASKED
ADC_SAR_Seq_cy_psoc4_sar__SAR_RANGE_INTR_SET EQU CYREG_SAR_RANGE_INTR_SET
ADC_SAR_Seq_cy_psoc4_sar__SAR_RANGE_THRES EQU CYREG_SAR_RANGE_THRES
ADC_SAR_Seq_cy_psoc4_sar__SAR_SAMPLE_CTRL EQU CYREG_SAR_SAMPLE_CTRL
ADC_SAR_Seq_cy_psoc4_sar__SAR_SAMPLE_TIME01 EQU CYREG_SAR_SAMPLE_TIME01
ADC_SAR_Seq_cy_psoc4_sar__SAR_SAMPLE_TIME23 EQU CYREG_SAR_SAMPLE_TIME23
ADC_SAR_Seq_cy_psoc4_sar__SAR_SATURATE_INTR_MASK EQU CYREG_SAR_SATURATE_INTR_MASK
ADC_SAR_Seq_cy_psoc4_sar__SAR_SATURATE_INTR_MASKED EQU CYREG_SAR_SATURATE_INTR_MASKED
ADC_SAR_Seq_cy_psoc4_sar__SAR_SATURATE_INTR_SET EQU CYREG_SAR_SATURATE_INTR_SET
ADC_SAR_Seq_cy_psoc4_sar__SAR_STATUS EQU CYREG_SAR_STATUS

; ADC_SAR_Seq_cy_psoc4_sarmux_8
ADC_SAR_Seq_cy_psoc4_sarmux_8__CH_0_PIN EQU 3
ADC_SAR_Seq_cy_psoc4_sarmux_8__CH_0_PORT EQU 7
ADC_SAR_Seq_cy_psoc4_sarmux_8__CH_1_PIN EQU 0
ADC_SAR_Seq_cy_psoc4_sarmux_8__CH_1_PORT EQU 7
ADC_SAR_Seq_cy_psoc4_sarmux_8__SAR_CHAN_CONFIG00 EQU CYREG_SAR_CHAN_CONFIG00
ADC_SAR_Seq_cy_psoc4_sarmux_8__SAR_CHAN_CONFIG01 EQU CYREG_SAR_CHAN_CONFIG01
ADC_SAR_Seq_cy_psoc4_sarmux_8__SAR_CHAN_CONFIG02 EQU CYREG_SAR_CHAN_CONFIG02
ADC_SAR_Seq_cy_psoc4_sarmux_8__SAR_CHAN_CONFIG03 EQU CYREG_SAR_CHAN_CONFIG03
ADC_SAR_Seq_cy_psoc4_sarmux_8__SAR_CHAN_CONFIG04 EQU CYREG_SAR_CHAN_CONFIG04
ADC_SAR_Seq_cy_psoc4_sarmux_8__SAR_CHAN_CONFIG05 EQU CYREG_SAR_CHAN_CONFIG05
ADC_SAR_Seq_cy_psoc4_sarmux_8__SAR_CHAN_CONFIG06 EQU CYREG_SAR_CHAN_CONFIG06
ADC_SAR_Seq_cy_psoc4_sarmux_8__SAR_CHAN_CONFIG07 EQU CYREG_SAR_CHAN_CONFIG07
ADC_SAR_Seq_cy_psoc4_sarmux_8__SAR_CHAN_EN EQU CYREG_SAR_CHAN_EN
ADC_SAR_Seq_cy_psoc4_sarmux_8__SAR_CHAN_RESULT_VALID EQU CYREG_SAR_CHAN_RESULT_VALID
ADC_SAR_Seq_cy_psoc4_sarmux_8__SAR_CHAN_RESULT00 EQU CYREG_SAR_CHAN_RESULT00
ADC_SAR_Seq_cy_psoc4_sarmux_8__SAR_CHAN_RESULT01 EQU CYREG_SAR_CHAN_RESULT01
ADC_SAR_Seq_cy_psoc4_sarmux_8__SAR_CHAN_RESULT02 EQU CYREG_SAR_CHAN_RESULT02
ADC_SAR_Seq_cy_psoc4_sarmux_8__SAR_CHAN_RESULT03 EQU CYREG_SAR_CHAN_RESULT03
ADC_SAR_Seq_cy_psoc4_sarmux_8__SAR_CHAN_RESULT04 EQU CYREG_SAR_CHAN_RESULT04
ADC_SAR_Seq_cy_psoc4_sarmux_8__SAR_CHAN_RESULT05 EQU CYREG_SAR_CHAN_RESULT05
ADC_SAR_Seq_cy_psoc4_sarmux_8__SAR_CHAN_RESULT06 EQU CYREG_SAR_CHAN_RESULT06
ADC_SAR_Seq_cy_psoc4_sarmux_8__SAR_CHAN_RESULT07 EQU CYREG_SAR_CHAN_RESULT07
ADC_SAR_Seq_cy_psoc4_sarmux_8__SAR_CHAN_WORK_VALID EQU CYREG_SAR_CHAN_WORK_VALID
ADC_SAR_Seq_cy_psoc4_sarmux_8__SAR_CHAN_WORK00 EQU CYREG_SAR_CHAN_WORK00
ADC_SAR_Seq_cy_psoc4_sarmux_8__SAR_CHAN_WORK01 EQU CYREG_SAR_CHAN_WORK01
ADC_SAR_Seq_cy_psoc4_sarmux_8__SAR_CHAN_WORK02 EQU CYREG_SAR_CHAN_WORK02
ADC_SAR_Seq_cy_psoc4_sarmux_8__SAR_CHAN_WORK03 EQU CYREG_SAR_CHAN_WORK03
ADC_SAR_Seq_cy_psoc4_sarmux_8__SAR_CHAN_WORK04 EQU CYREG_SAR_CHAN_WORK04
ADC_SAR_Seq_cy_psoc4_sarmux_8__SAR_CHAN_WORK05 EQU CYREG_SAR_CHAN_WORK05
ADC_SAR_Seq_cy_psoc4_sarmux_8__SAR_CHAN_WORK06 EQU CYREG_SAR_CHAN_WORK06
ADC_SAR_Seq_cy_psoc4_sarmux_8__SAR_CHAN_WORK07 EQU CYREG_SAR_CHAN_WORK07
ADC_SAR_Seq_cy_psoc4_sarmux_8__SAR_INJ_CHAN_CONFIG EQU CYREG_SAR_INJ_CHAN_CONFIG
ADC_SAR_Seq_cy_psoc4_sarmux_8__SAR_INJ_RESULT EQU CYREG_SAR_INJ_RESULT
ADC_SAR_Seq_cy_psoc4_sarmux_8__SAR_START_CTRL EQU CYREG_SAR_START_CTRL

; ADC_SAR_Seq_intClock
ADC_SAR_Seq_intClock__DIVIDER_MASK EQU 0x0000FFFF
ADC_SAR_Seq_intClock__ENABLE EQU CYREG_CLK_DIVIDER_A00
ADC_SAR_Seq_intClock__ENABLE_MASK EQU 0x80000000
ADC_SAR_Seq_intClock__MASK EQU 0x80000000
ADC_SAR_Seq_intClock__REGISTER EQU CYREG_CLK_DIVIDER_A00

; ADC_SAR_Seq_IRQ
ADC_SAR_Seq_IRQ__INTC_CLR_EN_REG EQU CYREG_CM0_ICER
ADC_SAR_Seq_IRQ__INTC_CLR_PD_REG EQU CYREG_CM0_ICPR
ADC_SAR_Seq_IRQ__INTC_MASK EQU 0x4000
ADC_SAR_Seq_IRQ__INTC_NUMBER EQU 14
ADC_SAR_Seq_IRQ__INTC_PRIOR_MASK EQU 0xC00000
ADC_SAR_Seq_IRQ__INTC_PRIOR_NUM EQU 3
ADC_SAR_Seq_IRQ__INTC_PRIOR_REG EQU CYREG_CM0_IPR3
ADC_SAR_Seq_IRQ__INTC_SET_EN_REG EQU CYREG_CM0_ISER
ADC_SAR_Seq_IRQ__INTC_SET_PD_REG EQU CYREG_CM0_ISPR

; Miscellaneous
CYDEV_BCLK__HFCLK__HZ EQU 24000000
CYDEV_BCLK__HFCLK__KHZ EQU 24000
CYDEV_BCLK__HFCLK__MHZ EQU 24
CYDEV_BCLK__SYSCLK__HZ EQU 24000000
CYDEV_BCLK__SYSCLK__KHZ EQU 24000
CYDEV_BCLK__SYSCLK__MHZ EQU 24
CYDEV_CHIP_DIE_LEOPARD EQU 1
CYDEV_CHIP_DIE_PANTHER EQU 18
CYDEV_CHIP_DIE_PSOC4A EQU 10
CYDEV_CHIP_DIE_PSOC5LP EQU 17
CYDEV_CHIP_DIE_TMA4 EQU 2
CYDEV_CHIP_DIE_UNKNOWN EQU 0
CYDEV_CHIP_FAMILY_PSOC3 EQU 1
CYDEV_CHIP_FAMILY_PSOC4 EQU 2
CYDEV_CHIP_FAMILY_PSOC5 EQU 3
CYDEV_CHIP_FAMILY_UNKNOWN EQU 0
CYDEV_CHIP_FAMILY_USED EQU CYDEV_CHIP_FAMILY_PSOC4
CYDEV_CHIP_JTAG_ID EQU 0x04C81193
CYDEV_CHIP_MEMBER_3A EQU 1
CYDEV_CHIP_MEMBER_4A EQU 10
CYDEV_CHIP_MEMBER_4C EQU 15
CYDEV_CHIP_MEMBER_4D EQU 6
CYDEV_CHIP_MEMBER_4E EQU 4
CYDEV_CHIP_MEMBER_4F EQU 11
CYDEV_CHIP_MEMBER_4G EQU 2
CYDEV_CHIP_MEMBER_4H EQU 9
CYDEV_CHIP_MEMBER_4I EQU 14
CYDEV_CHIP_MEMBER_4J EQU 7
CYDEV_CHIP_MEMBER_4K EQU 8
CYDEV_CHIP_MEMBER_4L EQU 13
CYDEV_CHIP_MEMBER_4M EQU 12
CYDEV_CHIP_MEMBER_4N EQU 5
CYDEV_CHIP_MEMBER_4U EQU 3
CYDEV_CHIP_MEMBER_5A EQU 17
CYDEV_CHIP_MEMBER_5B EQU 16
CYDEV_CHIP_MEMBER_UNKNOWN EQU 0
CYDEV_CHIP_MEMBER_USED EQU CYDEV_CHIP_MEMBER_4A
CYDEV_CHIP_DIE_EXPECT EQU CYDEV_CHIP_MEMBER_USED
CYDEV_CHIP_DIE_ACTUAL EQU CYDEV_CHIP_DIE_EXPECT
CYDEV_CHIP_REV_LEOPARD_ES1 EQU 0
CYDEV_CHIP_REV_LEOPARD_ES2 EQU 1
CYDEV_CHIP_REV_LEOPARD_ES3 EQU 3
CYDEV_CHIP_REV_LEOPARD_PRODUCTION EQU 3
CYDEV_CHIP_REV_PANTHER_ES0 EQU 0
CYDEV_CHIP_REV_PANTHER_ES1 EQU 1
CYDEV_CHIP_REV_PANTHER_PRODUCTION EQU 1
CYDEV_CHIP_REV_PSOC4A_ES0 EQU 17
CYDEV_CHIP_REV_PSOC4A_PRODUCTION EQU 17
CYDEV_CHIP_REV_PSOC5LP_ES0 EQU 0
CYDEV_CHIP_REV_PSOC5LP_PRODUCTION EQU 0
CYDEV_CHIP_REV_TMA4_ES EQU 17
CYDEV_CHIP_REV_TMA4_ES2 EQU 33
CYDEV_CHIP_REV_TMA4_PRODUCTION EQU 17
CYDEV_CHIP_REVISION_3A_ES1 EQU 0
CYDEV_CHIP_REVISION_3A_ES2 EQU 1
CYDEV_CHIP_REVISION_3A_ES3 EQU 3
CYDEV_CHIP_REVISION_3A_PRODUCTION EQU 3
CYDEV_CHIP_REVISION_4A_ES0 EQU 17
CYDEV_CHIP_REVISION_4A_PRODUCTION EQU 17
CYDEV_CHIP_REVISION_4C_PRODUCTION EQU 0
CYDEV_CHIP_REVISION_4D_PRODUCTION EQU 0
CYDEV_CHIP_REVISION_4E_PRODUCTION EQU 0
CYDEV_CHIP_REVISION_4F_PRODUCTION EQU 0
CYDEV_CHIP_REVISION_4F_PRODUCTION_256DMA EQU 0
CYDEV_CHIP_REVISION_4F_PRODUCTION_256K EQU 0
CYDEV_CHIP_REVISION_4G_ES EQU 17
CYDEV_CHIP_REVISION_4G_ES2 EQU 33
CYDEV_CHIP_REVISION_4G_PRODUCTION EQU 17
CYDEV_CHIP_REVISION_4H_PRODUCTION EQU 0
CYDEV_CHIP_REVISION_4I_PRODUCTION EQU 0
CYDEV_CHIP_REVISION_4J_PRODUCTION EQU 0
CYDEV_CHIP_REVISION_4K_PRODUCTION EQU 0
CYDEV_CHIP_REVISION_4L_PRODUCTION EQU 0
CYDEV_CHIP_REVISION_4M_PRODUCTION EQU 0
CYDEV_CHIP_REVISION_4N_PRODUCTION EQU 0
CYDEV_CHIP_REVISION_4U_PRODUCTION EQU 0
CYDEV_CHIP_REVISION_5A_ES0 EQU 0
CYDEV_CHIP_REVISION_5A_ES1 EQU 1
CYDEV_CHIP_REVISION_5A_PRODUCTION EQU 1
CYDEV_CHIP_REVISION_5B_ES0 EQU 0
CYDEV_CHIP_REVISION_5B_PRODUCTION EQU 0
CYDEV_CHIP_REVISION_USED EQU CYDEV_CHIP_REVISION_4A_PRODUCTION
CYDEV_CHIP_REV_EXPECT EQU CYDEV_CHIP_REVISION_USED
CYDEV_CONFIG_READ_ACCELERATOR EQU 1
CYDEV_CONFIG_UNUSED_IO_AllowButWarn EQU 0
CYDEV_CONFIG_UNUSED_IO EQU CYDEV_CONFIG_UNUSED_IO_AllowButWarn
CYDEV_CONFIG_UNUSED_IO_AllowWithInfo EQU 1
CYDEV_CONFIG_UNUSED_IO_Disallowed EQU 2
CYDEV_CONFIGURATION_COMPRESSED EQU 1
CYDEV_CONFIGURATION_MODE_COMPRESSED EQU 0
CYDEV_CONFIGURATION_MODE EQU CYDEV_CONFIGURATION_MODE_COMPRESSED
CYDEV_CONFIGURATION_MODE_DMA EQU 2
CYDEV_CONFIGURATION_MODE_UNCOMPRESSED EQU 1
CYDEV_DEBUG_PROTECT_KILL EQU 4
CYDEV_DEBUG_PROTECT_OPEN EQU 1
CYDEV_DEBUG_PROTECT EQU CYDEV_DEBUG_PROTECT_OPEN
CYDEV_DEBUG_PROTECT_PROTECTED EQU 2
CYDEV_DEBUGGING_DPS_Disable EQU 3
CYDEV_DEBUGGING_DPS_SWD EQU 2
CYDEV_DEBUGGING_DPS EQU CYDEV_DEBUGGING_DPS_SWD
CYDEV_DEBUGGING_ENABLE EQU 1
CYDEV_DFT_SELECT_CLK0 EQU 1
CYDEV_DFT_SELECT_CLK1 EQU 2
CYDEV_HEAP_SIZE EQU 0x80
CYDEV_IMO_TRIMMED_BY_USB EQU 0
CYDEV_IMO_TRIMMED_BY_WCO EQU 0
CYDEV_IS_EXPORTING_CODE EQU 0
CYDEV_IS_IMPORTING_CODE EQU 0
CYDEV_PROJ_TYPE EQU 0
CYDEV_PROJ_TYPE_BOOTLOADER EQU 1
CYDEV_PROJ_TYPE_LAUNCHER EQU 5
CYDEV_PROJ_TYPE_LOADABLE EQU 2
CYDEV_PROJ_TYPE_LOADABLEANDBOOTLOADER EQU 4
CYDEV_PROJ_TYPE_MULTIAPPBOOTLOADER EQU 3
CYDEV_PROJ_TYPE_STANDARD EQU 0
CYDEV_STACK_SIZE EQU 0x0400
CYDEV_USE_BUNDLED_CMSIS EQU 1
CYDEV_VARIABLE_VDDA EQU 1
CYDEV_VDDA_MV EQU 3300
CYDEV_VDDD_MV EQU 3300
CYDEV_WDT_GENERATE_ISR EQU 1
CYIPBLOCK_M0S8_CTBM_VERSION EQU 0
CYIPBLOCK_m0s8cpuss_VERSION EQU 0
CYIPBLOCK_m0s8csd_VERSION EQU 0
CYIPBLOCK_m0s8gpio2_VERSION EQU 0
CYIPBLOCK_m0s8hsiom4a_VERSION EQU 0
CYIPBLOCK_m0s8lcd_VERSION EQU 0
CYIPBLOCK_m0s8lpcomp_VERSION EQU 0
CYIPBLOCK_m0s8pclk_VERSION EQU 0
CYIPBLOCK_m0s8sar_VERSION EQU 0
CYIPBLOCK_m0s8scb_VERSION EQU 0
CYIPBLOCK_m0s8srssv2_VERSION EQU 1
CYIPBLOCK_m0s8tcpwm_VERSION EQU 0
CYIPBLOCK_m0s8udbif_VERSION EQU 0
CYIPBLOCK_S8_GPIO_VERSION EQU 2
CYDEV_BOOTLOADER_ENABLE EQU 0
    ENDIF
    END
